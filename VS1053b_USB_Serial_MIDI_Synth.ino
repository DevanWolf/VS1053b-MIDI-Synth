/**
 * Realime USB Serial MIDI Sound Module
 *
 * Turns your Arduino UNO into a fully working standalone USB/Serial General MIDI synth!
 *
 * Hardware:
 * - Arduino UNO (or compatible)
 * - VS1053b Module (e.g. Waveshare Music Shield)
 *
 * Pin Connections (Arduino UNO):
 * - MISO: Pin 12
 * - MOSI: Pin 11
 * - SCK: Pin 13
 * - DREQ: Pin A1
 * - XRST: Pin A0
 * - XCS: Pin A3
 * - XDCS: Pin A2
 *
 * Software:
 * - EA Serial MIDI Bridge (https://github.com/ezequielabregu/EA-serialmidi-bridge/releases)
 * or Hairless MIDI<->Serial (https://github.com/tyan0/hairless-midiserial/releases)
 * - loopMIDI (for Windows users) (https://tobias-erichsen.de/software/loopmidi.html)
 *
 * SysEx commands implemented and wrapped in this sketch:
 * FF - System Reset
 * F0 7E 7F 09 01 F7 - GM Reset
 * F0 7F 7F 04 01 xx vv F7 - Master Volume
 * F0 7F 7F 04 02 +x vv F7 - Master Balance
 * F0 00 01 11 01 0v F7 - EarSpeaker Setting
 * F0 00 01 11 02 bl th F7 - Bass & Treble Setting
 * F0 00 01 11 03 0v F7 - Reverb Setting
 *
 * Author: Sobble Entertainment Inc.
 */

#include <SPI.h>

// If you're using a different Arduino and/or a different music shield, change the below 4 pin IDs to their matching connections
#define XCS A3
#define XDCS A2
#define DREQ A1
#define XRESET A0

// Button definitions, remove one of the lines below to disable its function in case of different music shields without buttons (e.g. Sparkfun MP3 Shield, Adafruit Music Maker)
#define REVERB_TOGGLE 5 // mapped to Play/Pause button
#define RESET 6 // mapped to Left/Previous button
#define VOLUME_UP 3
#define VOLUME_DOWN 7

#define LED 8 // Remove this line to disable the panel activity LED

const word plg[] PROGMEM = {7,1,0x8050,6,0x03f0,0x2800,0x8080,6,0x2016,0xf400,0x4095,6,0x17,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1,0x50}; // using full plugin for full support because the minimal plugin uses 4 note polyphony and no reverb
#define MAX_SYSEX_BYTES 6 // should not be changed unless you added more custom SysEx messages to the code yourself
byte cmd, volume, sysex[MAX_SYSEX_BYTES];
char value, balance;
#ifdef REVERB_TOGGLE
bool reverbOff, debounce;
#elif defined(RESET)
bool debounce;
#endif

void writeRegisterSplit(byte address, byte valueM, byte valueL) {
	digitalWrite(XCS, LOW);
	SPI.transfer(2);
	SPI.transfer(address);
	SPI.transfer(valueM);
	SPI.transfer(valueL);
	digitalWrite(XCS, HIGH);
}

void writeRegister(byte address, word value) {
	writeRegisterSplit(address, value >> 8, value & 0xFF);
}

void updateVolume() {
	writeRegisterSplit(0x0B, volume + max(balance, 0), volume + max(-balance, 0));
}

#if defined(VOLUME_UP) && defined(VOLUME_DOWN)
void volumeControl() {
		updateVolume();
#ifdef LED
		digitalWrite(LED, HIGH);
		delayMicroseconds(191 - volume << 6);
		digitalWrite(LED, LOW);
		delayMicroseconds(volume + 65 << 6);
#else
		delay(10);
#endif
}
#endif

void SPI_transfer8bit(byte data) {
	SPI.transfer(0);
	SPI.transfer(data);
}

void resetMIDI() {
	value = 0;
	balance = 0;
	writeRegisterSplit(0x0A, 0, 0x50);
}

void reset() {
	if (cmd != 0 and value != 0) {
		cmd = 0;
		resetMIDI();
#if defined(VOLUME_UP) && defined(VOLUME_DOWN)
		if (volume > 0) updateVolume();
#else
		volume = 0;
#endif
	}
}

void setup() {
	pinMode(XCS, OUTPUT);
	digitalWrite(XCS, HIGH);
	pinMode(XDCS, OUTPUT);
	digitalWrite(XDCS, HIGH);
	pinMode(XRESET, OUTPUT);
	digitalWrite(XRESET, HIGH);
#ifdef LED
	pinMode(LED, OUTPUT);
#endif

	SPI.begin();
	SPI.setClockDivider(SPI_CLOCK_DIV8);

	while (!digitalRead(DREQ));

	word i = 0;
	while (i < sizeof plg >> 1) {
		word addr = pgm_read_word_near(&plg[i++]);
		word n = pgm_read_word_near(&plg[i++]);
		if (n & 0x8000U) { // RLE run
			n &= 0x7FFF;
			word val = pgm_read_word_near(&plg[i++]);
			while (n--) writeRegister(addr, val);
		} else // Copy run
			while (n--) writeRegister(addr, pgm_read_word_near(&plg[i++]));
	}

	Serial.begin(115200); // Use instead 57600 for Serial <> MIDI Converter, 38400 for Serial MIDI compatible baud rate, or 31250 for the standard MIDI protocol or USBMidiKliK
}

void loop() {
	while (Serial.available()) {
		byte data = Serial.read();
		if (data >> 5 == 4 or data >> 4 == 11 or data >> 4 == 12 or data >> 4 == 14 or data == 0xF0) {
			cmd = data;
			value = -1;
		} else if (data < 0x80) {
			if (cmd >> 5 == 4 or cmd >> 4 == 11 or cmd >> 4 == 14) {
				if (value < 0) value = data;
				else {
					if (!(cmd >> 4 == 11 and ((value >= 1 and value <= 5) or value == 8 or value == 9 or (value >= 13 and value <= 37) or value == 65 or (value >= 67 and value <= 90) or (value >= 92 and value <= 97) or (value >= 102 and value <= 119) or value == 122 or value == 126 or value == 127))) { // filter out unassigned CCs
						digitalWrite(XDCS, LOW);
						SPI_transfer8bit(cmd);
						SPI_transfer8bit(value);
						SPI_transfer8bit(cmd >> 4 == 8 ? 0 : data);
						digitalWrite(XDCS, HIGH);
					}
					value = -1;
				}
			} else if (cmd >> 5 == 6) {
				digitalWrite(XDCS, LOW);
				SPI_transfer8bit(cmd);
				SPI_transfer8bit(data);
				digitalWrite(XDCS, HIGH);
			} else if (cmd == 0xF0) {
				if (value < MAX_SYSEX_BYTES) sysex[++value] = data;
				else {
					memset(sysex, NULL, sizeof sysex);
					cmd = 0;
				}
			}
		} else if (data == 0xFF) reset();
		else {
			if (data == 0xF7 and cmd == 0xF0) {
				if (sysex[1] == 0x7F) {
					if (sysex[0] == 0x7E and sysex[2] == 9 and (sysex[3] == 1 or sysex[3] == 3) and value == 3) {
						volume = 0;
						resetMIDI();
					} else if (sysex[0] == 0x7F and sysex[2] == 4 and value == 5) {
						if (sysex[3] == 1) {
							volume = 127 - sysex[5];
							updateVolume();
						} else if (sysex[3] == 2) {
							balance = sysex[5] + ((byte)sysex[4] >= 0x40) - 64;
							updateVolume();
						}
					}
				} else if (sysex[0] == 0 and sysex[1] == 1 and sysex[2] == 0x11) {
					if (sysex[3] == 1 and sysex[4] < 4 and value == 4) writeRegisterSplit(0, 8, (sysex[4] & 1) << 4 | (sysex[4] & 2) << 6);
					if (sysex[3] == 2 and value == 5) writeRegisterSplit(2, sysex[5], sysex[4]);
					else if (sysex[3] == 3 and sysex[4] < 0x10 and value == 4) {
						writeRegisterSplit(7, 0x1e, 3);
						writeRegisterSplit(6, 0, sysex[4]);
#ifdef REVERB_TOGGLE
						reverbOff = sysex[4] == 1;
#endif
					}
				}
				memset(sysex, NULL, sizeof sysex);
			}
			cmd = 0;
		}
	}
#ifdef REVERB_TOGGLE
	if (!digitalRead(REVERB_TOGGLE) and !debounce) {
		debounce = true;
#ifdef LED
		digitalWrite(LED, HIGH);
#endif
		reverbOff = !reverbOff;
		writeRegisterSplit(7, 0x1e, 3);
		writeRegisterSplit(6, 0, (byte)reverbOff);
#ifdef LED
		if (!reverbOff) delay(5);
		digitalWrite(LED, LOW);
#endif
	} else
#ifndef RESET
	if (digitalRead(REVERB_TOGGLE) and debounce) debounce = false;
#endif
#endif
#ifdef RESET
	if (!digitalRead(RESET) and !debounce) {
		debounce = true;
#ifdef LED
		digitalWrite(LED, HIGH);
#endif
		reset();
#ifdef LED
		digitalWrite(LED, LOW);
#endif
	} else if (
#ifdef REVERB_TOGGLE
	digitalRead(REVERB_TOGGLE) and 
#endif
	digitalRead(RESET) and debounce) debounce = false;
#endif
#if defined(VOLUME_UP) && defined(VOLUME_DOWN)
	if (!digitalRead(VOLUME_UP) and volume > 0) {
		--volume;
		volumeControl();
	} 
	else if (!digitalRead(VOLUME_DOWN) and volume < 191) {
		++volume;
		volumeControl();
	}
#endif
}